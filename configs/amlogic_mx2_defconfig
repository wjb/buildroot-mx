## configs/amlogic_mx2_defconfig
```kconfig
BR2_arm=y
BR2_cortex_a9=y
BR2_ARM_EABIHF=y
BR2_ARM_ENABLE_NEON=y
BR2_ARM_FPU_VFPV3D16=y
BR2_ARM_INSTRUCTIONS_THUMB2=y
BR2_ARM_AMLOGIC=y
BR2_BOARD_TYPE_AMLOGIC_M6=y
BR2_JLEVEL=8
BR2_STRIP_EXCLUDE_FILES="xbmc.bin libavformat.so.53.4.0 libamplayer.so libamcodec.so.0.0 libamadec.so"
BR2_STRIP_EXCLUDE_DIRS="output/target/lib /lib lib"
BR2_OPTIMIZE_2=y
BR2_TOOLCHAIN_EXTERNAL=y
BR2_TOOLCHAIN_EXTERNAL_LINARO_2013_04=y
BR2_TOOLCHAIN_EXTERNAL_LINARO_GCONV=y
BR2_PACKAGE_HOST_GDB=y
BR2_TARGET_GENERIC_HOSTNAME="AMLinux"
BR2_TARGET_GENERIC_ISSUE="Welcome to AMLinux"
BR2_TARGET_GENERIC_PASSWD_DES=y
BR2_INIT_SYSTEMD=y
BR2_TARGET_GENERIC_ROOT_PASSWD="letmein"
BR2_ROOTFS_OVERLAY="board/amlogic/mx2ref/overlay"
BR2_LINUX_KERNEL=y
BR2_PREBUILT_LINUX=y
BR2_PREBUILT_LINUX_PATH="board/amlogic/mx2ref/kernel"
BR2_PREBUILT_LINUX_MODS="3.0.50"
BR2_PREBUILT_LINUX_IMAGE="uImage"
BR2_BUSYBOX_VERSION_1_21_X=y
BR2_PACKAGE_BUSYBOX_CONFIG="board/amlogic/mx2ref/mx2-busybox.config"
BR2_PACKAGE_ALSA_UTILS_ALSACONF=y
BR2_PACKAGE_ALSA_UTILS_AMIXER=y
BR2_PACKAGE_ALSA_UTILS_APLAY=y
BR2_PACKAGE_ALSA_UTILS_IECSET=y
BR2_PACKAGE_ALSA_UTILS_SPEAKER_TEST=y
BR2_PACKAGE_MPG123=y
BR2_PACKAGE_SPEEDTEST_CLI=y
# BR2_PACKAGE_BOBLIGHT_LIBUSB is not set
BR2_PACKAGE_EVENTLIRCD=y
BR2_PACKAGE_XBMC=y
BR2_XBMC_REMOTE_CONF="gbox_remote.conf"
BR2_PACKAGE_XBMC_ADDON_SVCAMLSETTINGS=y
BR2_PACKAGE_OPENGL_API20=y
BR2_PACKAGE_LZOP=y
BR2_PACKAGE_GDB=y
BR2_PACKAGE_GDB_DEBUGGER=y
BR2_PACKAGE_STRACE=y
BR2_PACKAGE_CIFS_UTILS=y
BR2_PACKAGE_E2FSPROGS=y
BR2_PACKAGE_MTD=y
# BR2_PACKAGE_MTD_MTD_DEBUG is not set
# BR2_PACKAGE_MTD_MTDINFO is not set
# BR2_PACKAGE_MTD_UBIATTACH is not set
# BR2_PACKAGE_MTD_UBICRC32 is not set
# BR2_PACKAGE_MTD_UBIDETACH is not set
# BR2_PACKAGE_MTD_UBIFORMAT is not set
# BR2_PACKAGE_MTD_UBIMKVOL is not set
# BR2_PACKAGE_MTD_UBINFO is not set
# BR2_PACKAGE_MTD_UBINIZE is not set
# BR2_PACKAGE_MTD_UBIRENAME is not set
# BR2_PACKAGE_MTD_UBIRMVOL is not set
# BR2_PACKAGE_MTD_UBIRSVOL is not set
# BR2_PACKAGE_MTD_UBIUPDATEVOL is not set
BR2_PACKAGE_NTFS_3G=y
BR2_PACKAGE_NTFS_3G_ENCRYPTED=y
BR2_PACKAGE_NTFS_3G_NTFSPROGS=y
BR2_PACKAGE_SQUASHFS=y
BR2_PACKAGE_SQUASHFS_LZMA=y
BR2_PACKAGE_SQUASHFS_LZO=y
BR2_PACKAGE_SQUASHFS_XZ=y
BR2_PACKAGE_FBDUMP=y
BR2_PACKAGE_FBGRAB=y
BR2_PACKAGE_FBSET=y
BR2_PACKAGE_DBUS_PYTHON=y
BR2_PACKAGE_PYGOBJECT=y
BR2_PACKAGE_EVTEST=y
BR2_PACKAGE_EVTEST_CAPTURE=y
BR2_PACKAGE_HWDATA=y
BR2_PACKAGE_I2C_TOOLS=y
BR2_PACKAGE_INPUT_TOOLS=y
BR2_PACKAGE_LSHW=y
BR2_PACKAGE_LSUIO=y
BR2_PACKAGE_UBOOT_TOOLS=y
BR2_PACKAGE_USBMOUNT=y
BR2_PACKAGE_USBUTILS=y
BR2_PACKAGE_USBUTILS_ZLIB=y
BR2_PACKAGE_LIBID3TAG=y
BR2_PACKAGE_TAGLIB_MP4=y
BR2_PACKAGE_TAGLIB_ASF=y
BR2_PACKAGE_PIXMAN=y
BR2_PACKAGE_LIBV4L=y
BR2_PACKAGE_LIBV4L_IR_KEYTABLE=y
# BR2_PACKAGE_LIBV4L_V4L2_CTL is not set
BR2_PACKAGE_LIBXSLT=y
BR2_PACKAGE_LIBNL_TOOLS=y
BR2_PACKAGE_LIBTIRPC=y
BR2_PACKAGE_TZDATA=y
BR2_PACKAGE_LIBENCA=y
# BR2_PACKAGE_AVAHI_AUTOIPD is not set
BR2_PACKAGE_BLUEZ_UTILS=y
BR2_PACKAGE_BLUEZ_UTILS_COMPAT=y
BR2_PACKAGE_BLUEZ_UTILS_AUDIO=y
BR2_PACKAGE_BLUEZ_UTILS_USB=y
BR2_PACKAGE_CONNMAN=y
BR2_PACKAGE_CONNMAN_WIFI=y
BR2_PACKAGE_CONNMAN_LOOPBACK=y
BR2_PACKAGE_CONNMAN_DEBUG=y
BR2_PACKAGE_CONNMAN_CLIENT=y
BR2_PACKAGE_ETHTOOL=y
BR2_PACKAGE_IFTOP=y
BR2_PACKAGE_IPERF=y
BR2_PACKAGE_IW=y
BR2_PACKAGE_NETCAT=y
BR2_PACKAGE_NTP=y
BR2_PACKAGE_NTP_NTPDATE=y
BR2_PACKAGE_OPENSSH=y
BR2_PACKAGE_OPENVPN=y
BR2_PACKAGE_PPPD=y
BR2_PACKAGE_PPPD_FILTER=y
BR2_PACKAGE_PPPD_RADIUS=y
BR2_PACKAGE_PPTP_LINUX=y
BR2_PACKAGE_PROFTPD=y
BR2_PACKAGE_TCPDUMP=y
BR2_PACKAGE_TCPDUMP_SMB=y
BR2_PACKAGE_WGET=y
BR2_PACKAGE_WIRELESS_TOOLS=y
BR2_PACKAGE_WIRELESS_TOOLS_LIB=y
BR2_PACKAGE_WPA_SUPPLICANT_EAP=y
BR2_PACKAGE_WPA_SUPPLICANT_CLI=y
BR2_PACKAGE_WPA_SUPPLICANT_PASSPHRASE=y
BR2_PACKAGE_WPA_SUPPLICANT_DBUS_NEW=y
BR2_PACKAGE_WPA_SUPPLICANT_DBUS_INTROSPECTION=y
BR2_PACKAGE_WPA_SUPPLICANT_WPS=y
BR2_PACKAGE_ACL=y
BR2_PACKAGE_UTIL_LINUX_BINARIES=y
BR2_PACKAGE_UTIL_LINUX_MOUNT=y
BR2_PACKAGE_NANO=y
# BR2_PACKAGE_NANO_TINY is not set
BR2_TARGET_ROOTFS_RECOVERY_AML=y
BR2_TARGET_ROOTFS_RECOVERY_AML_BOARDNAME="mx2ref g18ref"
BR2_TARGET_ROOTFS_RECOVERY_AML_UPDATE_ZIP_PREFIX="MX2"
BR2_TARGET_ROOTFS_RECOVERY_AML_LOGO="fs/recovery_aml/aml_logo.img"
BR2_TARGET_ROOTFS_RECOVERY_BOOTLOADER_IMG="board/amlogic/mx2ref/bootloader.img"
BR2_TARGET_ROOTFS_RECOVERY_RECOVERY_IMG="board/amlogic/mx2ref/recovery.img"
BR2_TARGET_ROOTFS_RECOVERY_AML_APPEND_INITRD="/sdc1/BLD/buildroot-nextgen/board/amlogic/mx2ref/ramdisk"
```

## fs/recovery_aml/Config.in
```kconfig
config BR2_TARGET_ROOTFS_RECOVERY_AML
	bool "AMLogic Recovery Image"
        select BR2_TARGET_ROOTFS_TAR_AML
        select BR2_PACKAGE_RECOVERY_REBOOT
	help
	  Image ready for flashing via android's recovery partition

config BR2_TARGET_ROOTFS_RECOVERY_AML_BOARDNAME
	string "default_name"
	depends on BR2_TARGET_ROOTFS_RECOVERY_AML
	help
	 Name of the Android board (ro.product.board)

choice
      prompt "Update package file name"
      default BR2_TARGET_ROOTFS_RECOVERY_AML_UPDATE_ZIP_NAME_FULL_DATETIME
      depends on BR2_TARGET_ROOTFS_RECOVERY_AML
      help
	Choose how update package will be named

config BR2_TARGET_ROOTFS_RECOVERY_AML_UPDATE_ZIP_NAME_FULL_DATETIME
      bool "Boardname-DDMMMYYYY-hhmmss-update.zip"
      
config BR2_TARGET_ROOTFS_RECOVERY_AML_UPDATE_ZIP_NAME_SHORT_DATE
      bool "Boardname-YYMMDD-update.zip

config BR2_TARGET_ROOTFS_RECOVERY_AML_UPDATE_ZIP_NAME_BOARDNAME_UPDATE_ZIP
      bool "Boardname-update.zip"
      
config BR2_TARGET_ROOTFS_RECOVERY_AML_UPDATE_ZIP_NAME_UPDATE_ZIP
      bool "update.zip"

endchoice

choice
        prompt "Erase Userdata"
        default BR2_TARGET_ROOTFS_RECOVERY_AML_WIPE_USERDATA_CONDITIONAL
        depends on BR2_TARGET_ROOTFS_RECOVERY_AML
        help
          Whether to wipe the userdata partition

config BR2_TARGET_ROOTFS_RECOVERY_AML_WIPE_USERDATA_CONDITIONAL
       bool "yes if previous install was not linux"

config BR2_TARGET_ROOTFS_RECOVERY_AML_WIPE_USERDATA
       bool "yes"

config BR2_TARGET_ROOTFS_RECOVERY_AML_WIPE_USERDATA_NEVER
       bool "no"

endchoice

config BR2_TARGET_ROOTFS_RECOVERY_AML_LOGO
       string "Bootloader logo (Windows bitmap, up to 1280x720px)
       depends on BR2_TARGET_ROOTFS_RECOVERY_AML
       default ""
       help
	  Replaces default black logo which is shown on boot.

config BR2_TARGET_ROOTFS_RECOVERY_AML_IMGPACK
      bool "Use imgpack tool to pack images that will be stored to logo partition
      help
	Logo partition is newly introduced partition used on MX U-Boot. It stores
	packed bitmap images

config BR2_TARGET_ROOTFS_RECOVERY_AML_IMGPACK_CUSTOM
      string "Specify path to custom img_pack folder"
      depends on BR2_TARGET_ROOTFS_RECOVERY_AML_IMGPACK
      default ""
      help
	Custom images for Logo partition. For reference see fs/recovery_aml/img_pack.
	We should only be interested in changing 'bootup' file, which is basically
	Windows Bitmap file format with resolution 1280x720px or 1920x1080px
```

## package/pygobject/Config.in
```kconfig
config BR2_PACKAGE_PYGOBJECT
	bool "pygobject"
	depends on BR2_USE_WCHAR # glib2
	depends on BR2_PACKAGE_LIBGLIB2
	depends on BR2_PACKAGE_PYTHON
	select BR2_PACKAGE_LIBFFI
	help
          PyGObject provides a convenient wrapper for the GObject+ library for use in Python programs,
          and takes care of many of the boring details such as managing memory and type casting.
          When combined with PyGTK, PyORBit and gnome-python, it can be used to write full featured
          Gnome applications.

          http://www.pygtk.org/

comment "pygobject requires a toolchain with WCHAR support"
	depends on BR2_PACKAGE_LIBGLIB2 && BR2_PACKAGE_PYTHON && !BR2_USE_WCHAR
```

## package/thirdparty/Config.in
```kconfig
menu "XBMC and its Dependencies"
source "package/thirdparty/libshairport/Config.in"
source "package/thirdparty/libssh/Config.in"
source "package/thirdparty/lirc/Config.in"
source "package/thirdparty/afpfs-ng/Config.in"
source "package/thirdparty/librtmp/Config.in"
source "package/thirdparty/recovery_reboot/Config.in"
source "package/thirdparty/speedtest_cli/Config.in"
source "package/thirdparty/xbmc/Config.in"
source "package/thirdparty/xbmcaddons/Config.in"
source "package/thirdparty/xbmcpvr/Config.in"
source "package/thirdparty/boblight/Config.in"
source "package/thirdparty/eventlircd/Config.in"
endmenu
```

## package/thirdparty/eventlircd/Config.in
```kconfig
config BR2_PACKAGE_EVENTLIRCD
        bool "eventlircd"
        help
          Linux Remote Control Driver/Daemon

          http://code.google.com/p/eventlircd
```

## package/thirdparty/udevil/Config.in
```kconfig
config BR2_PACKAGE_UDEVIL
        bool "udevil"
        help
          mount/unmount without password, show info, monitor changes

          udevil is a command line Linux program which mounts and unmounts 
          removable devices without a password, shows device info, and monitors 
          device changes. It can also mount ISO files, nfs://, smb://, ftp://, 
          ssh:// and WebDAV URLs, and tmpfs/ramfs filesystems.

          https://github.com/IgnorantGuru/udevil
```

## package/thirdparty/xbmcaddons/Config.in
```kconfig
menu "XBMC addons"
    depends on BR2_PACKAGE_XBMC

comment "XBMC services"

source "package/thirdparty/xbmcaddons/svcamlsettings/Config.in"

comment "XBMC scripts"

endmenu
```

## package/thirdparty/xbmcaddons/svcamlsettings/Config.in
```kconfig
config BR2_PACKAGE_XBMC_ADDON_SVCAMLSETTINGS
    bool "service.amlinux.settings"
    depends on BR2_PACKAGE_XBMC
    default n
    help
      AMLinux Settings Addon
```
